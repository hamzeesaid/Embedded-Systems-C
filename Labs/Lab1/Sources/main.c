/********************************************************************/
// HC12 Program:  Lab 1- Timed LEDs
// Processor:     MC9S12XDP512
// Bus Speed:     8 MHz
// Author:        Hamza Said
// Details:       This program is biquaternary counter using the
//                LED's as an output

// Date:          sep 28 2021
// Revision History :
//

/********************************************************************/

/********************************************************************/
// Library includes
/********************************************************************/

#include <hidef.h>      /* common defines and macros */
#include "derivative.h" /* derivative-specific definitions */
#include "hal.h"
#include "SwLED_Lib.h" 


/********************************************************************/
// Local Prototypes
/********************************************************************/
//void DelayMilliseconds(uint time);
void Delay_1us(void);
/********************************************************************/
// Global Variables
/********************************************************************/
int i; // for bits itteration
int k; //used for delay
/********************************************************************/
// Constants
/********************************************************************/

/********************************************************************/
// Main Entry
/********************************************************************/
void main(void)
{
  // main entry point
  _DISABLE_COP();
  //EnableInterrupts;

  /********************************************************************/
  // initializations
  /********************************************************************/
  SwLED_Init();

  /********************************************************************/
  // main program loop
  /********************************************************************/
  for (;;)
  {

    // delay
    Delay_1us();

    // reset port to it's initial condition
    PT1AD1 &= 0b00011111;

    for (i = 0; i < 6; i++)
    {

      // if the counter reaches bit 6, begin counting
      if (PT1AD1 == 0b11000000)
      {
        //delay
        Delay_1us();
        PT1AD1 = 0b00100000;
      }

      // delay
      Delay_1us();
      // jump esvery 2 bit
      PT1AD1 += 0b01000000;
    }
  }
}

/********************************************************************/
// Functions
/********************************************************************/
void Delay_1us()
{
  for (k = 0; k < 100; k++)
  {
    Delay10ms_asm();
  }
}
/********************************************************************/
// Interrupt Service Routines
/********************************************************************/
